## Kconfig
```kconfig
mainmenu "HouseOS Configuration"

menu "Image build"

config IMG_SECTORS
    int "Disk image size (sectors)"
    default 131072

menu "Bootloader"

config BOOT_DYNAMIC_PARAMS
    bool "Enable dynamic boot parameters from /dev/bootloader"
    default y

config BOOT_FLAGS_EXTRA
    hex "Extra boot flags bitmask"
    default 0x0

endmenu

menu "Memory layout (advanced)"

config INITRAMFS_LOAD_ADDR
    hex "Initramfs load address"
    default 0x00100000

endmenu

endmenu

menu "Kernel"

menu "File systems"

config KERNEL_FS_DEVFS
    bool "devfs"
    default y

config KERNEL_FS_PROCFS
    bool "procfs"
    default y

config KERNEL_FS_FAT32
    bool "fat32"
    default y

endmenu

menu "Device drivers"

config PS2_KEYBOARD
    bool "PS/2 keyboard"
    default y

config PS2_MOUSE
    bool "PS/2 mouse"
    default y

endmenu

menu "Graphics"

choice
    prompt "Graphics backend"
    default GRAPHICS_BACKEND_VGA

config GRAPHICS_BACKEND_VGA
    bool "VGA text mode"

config GRAPHICS_BACKEND_VESA
    bool "VESA framebuffer"

endchoice

config GRAPHICS_VGA_MODE
    hex "VGA mode"
    depends on GRAPHICS_BACKEND_VGA
    default 0x03

config GRAPHICS_VESA_MODE
    hex "VESA mode"
    depends on GRAPHICS_BACKEND_VESA
    default 0x0118

config VESA_ROTATION
    bool "Enable runtime VESA rotation"
    depends on GRAPHICS_BACKEND_VESA
    default y

config GSHELL
    bool "Graphical shell"
    default n

endmenu

endmenu

menu "Debug"

config BOOT_DEBUG
    bool "Bootloader (stage2) debug messages"
    default n

config DEBUG_KERNEL_SERIAL_LOG
    bool "Verbose kernel serial logs"
    default y

endmenu

menu "Userland applets"

menu "Files"

config APPLET_PWD
    bool "pwd"
    default y

config APPLET_LS
    bool "ls"
    default y

config APPLET_CAT
    bool "cat"
    default y

config APPLET_GREP
    bool "grep"
    default y

config APPLET_LESS
    bool "less"
    default n

config APPLET_MKDIR
    bool "mkdir"
    default y

config APPLET_MKFIFO
    bool "mkfifo"
    default n

config APPLET_MKSOCK
    bool "mksock"
    default n

config APPLET_TOUCH
    bool "touch"
    default y

config APPLET_RM
    bool "rm"
    default y

config APPLET_RMDIR
    bool "rmdir"
    default y

config APPLET_CP
    bool "cp"
    default y

config APPLET_MV
    bool "mv"
    default y

config APPLET_LN
    bool "ln"
    default y

config APPLET_TEE
    bool "tee"
    default y

config APPLET_MOUNT
    bool "mount"
    default y

config APPLET_UMOUNT
    bool "umount"
    default y

config APPLET_LSBLK
    bool "lsblk"
    depends on KERNEL_FS_DEVFS
    default n

endmenu

menu "System"

config APPLET_ECHO
    bool "echo"
    default y

config APPLET_PRINTF
    bool "printf"
    default y

config APPLET_HEXDUMP
    bool "hexdump"
    default n

config APPLET_REBOOT
    bool "reboot"
    depends on KERNEL_FS_DEVFS
    default y

config APPLET_POWEROFF
    bool "poweroff"
    depends on KERNEL_FS_DEVFS
    default y

config APPLET_BOOTLOADER
    bool "bootloader"
    depends on BOOT_DYNAMIC_PARAMS && KERNEL_FS_DEVFS
    default n

endmenu

menu "Network"

config APPLET_UDP
    bool "udp"
    default n

endmenu

menu "Display and input"

config APPLET_CHVT
    bool "chvt"
    depends on KERNEL_FS_DEVFS
    default n

config APPLET_TTYINFO
    bool "ttyinfo"
    default n

config APPLET_KBDINFO
    bool "kbdinfo"
    depends on KERNEL_FS_DEVFS && PS2_KEYBOARD
    default n

config APPLET_MOUSEINFO
    bool "mouseinfo"
    depends on KERNEL_FS_DEVFS && PS2_MOUSE
    default n

config APPLET_VESA
    bool "vesa"
    depends on KERNEL_FS_DEVFS && GRAPHICS_BACKEND_VESA
    default n

config APPLET_VGA
    bool "vga"
    depends on KERNEL_FS_DEVFS && GRAPHICS_BACKEND_VGA
    default n

endmenu

endmenu

menu "Run options"

config QEMU_MEM
    string "QEMU memory"
    default "4G"

config QEMU_SERIAL
    string "QEMU serial"
    default "stdio"

endmenu
```

## configs/houseos_defconfig
```kconfig
CONFIG_IMG_SECTORS=131072
CONFIG_BOOT_DYNAMIC_PARAMS=y
# CONFIG_BOOT_DEBUG is not set
CONFIG_BOOT_FLAGS_EXTRA=0x0
CONFIG_INITRAMFS_LOAD_ADDR=0x00100000
CONFIG_KERNEL_FS_DEVFS=y
CONFIG_KERNEL_FS_PROCFS=y
CONFIG_KERNEL_FS_FAT32=y
CONFIG_PS2_KEYBOARD=y
CONFIG_PS2_MOUSE=y
CONFIG_GRAPHICS_BACKEND_VGA=y
# CONFIG_GRAPHICS_BACKEND_VESA is not set
CONFIG_GRAPHICS_VGA_MODE=0x03
# CONFIG_GSHELL is not set
CONFIG_DEBUG_KERNEL_SERIAL_LOG=y
CONFIG_APPLET_PWD=y
CONFIG_APPLET_LS=y
CONFIG_APPLET_CAT=y
CONFIG_APPLET_GREP=y
# CONFIG_APPLET_LESS is not set
CONFIG_APPLET_MKDIR=y
# CONFIG_APPLET_MKFIFO is not set
# CONFIG_APPLET_MKSOCK is not set
CONFIG_APPLET_TOUCH=y
CONFIG_APPLET_RM=y
CONFIG_APPLET_RMDIR=y
CONFIG_APPLET_CP=y
CONFIG_APPLET_MV=y
CONFIG_APPLET_LN=y
CONFIG_APPLET_TEE=y
CONFIG_APPLET_MOUNT=y
CONFIG_APPLET_UMOUNT=y
# CONFIG_APPLET_LSBLK is not set
CONFIG_APPLET_ECHO=y
CONFIG_APPLET_PRINTF=y
# CONFIG_APPLET_HEXDUMP is not set
CONFIG_APPLET_REBOOT=y
CONFIG_APPLET_POWEROFF=y
# CONFIG_APPLET_BOOTLOADER is not set
# CONFIG_APPLET_UDP is not set
# CONFIG_APPLET_CHVT is not set
# CONFIG_APPLET_TTYINFO is not set
# CONFIG_APPLET_KBDINFO is not set
# CONFIG_APPLET_MOUSEINFO is not set
# CONFIG_APPLET_VESA is not set
# CONFIG_APPLET_VGA is not set
CONFIG_QEMU_MEM="4G"
CONFIG_QEMU_SERIAL="stdio"
```
